#pragma once
#include <Adafruit_GFX.h>
#include <pgmspace.h>

// Fixed-cell 7x11 clock digits. Each glyph is 11 rows; bit 6 is the leftmost column.
// Drawn in fixed cells so the time never jitters when digits change.
namespace digits7x11 {
  constexpr uint8_t W = 7, H = 11;
  constexpr uint8_t CELL = 8;        // digit cell advance (7 px glyph + 1 px gap)
  constexpr uint8_t COLON_CELL = 4;  // colon cell advance

  static const uint8_t GLYPHS[11][H] PROGMEM = {
    {0x3E,0x63,0x63,0x63,0x63,0x63,0x63,0x63,0x63,0x63,0x3E}, // 0
    {0x0C,0x1C,0x3C,0x0C,0x0C,0x0C,0x0C,0x0C,0x0C,0x0C,0x3F}, // 1
    {0x3E,0x63,0x03,0x03,0x06,0x0C,0x18,0x30,0x60,0x60,0x7F}, // 2
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    {0x00,0x00,0x00,0x18,0x18,0x00,0x00,0x18,0x18,0x00,0x00}, // : (index 10)
  };

  // Draws one glyph ('0'-'9', ':'; anything else draws nothing) with its top-left at (x, y).
  inline void draw(Adafruit_GFX& g, int16_t x, int16_t y, char c, uint16_t color) {
    int idx;
    if (c >= '0' && c <= '9') idx = c - '0';
    else if (c == ':') idx = 10;
    else return;
    for (uint8_t row = 0; row < H; row++) {
      uint8_t bits = pgm_read_byte(&GLYPHS[idx][row]);
      for (uint8_t col = 0; col < W; col++) {
        if (bits & (0x40 >> col)) g.drawPixel(x + col, y + row, color);
      }
    }
  }
}
